## example/Kconfig
```kconfig
#
# For a description of the syntax of this configuration file,
# see Documentation/kbuild/kconfig-language.txt.
#
mainmenu "Linux/$ARCH $KERNELVERSION Kernel Configuration"

comment "Project Options (add here)"


menu MDS_MODULES
	config MDS_JAVA
	bool "Enable java module"
	default y

	config MDS_LV
	bool "Enable labview module"
	default y

	config MDS_NI
	bool "Enable National Instruments module"
	default y
endmenu

menu MODULES
	config MOD1
	bool "Enable mod1 module"


	config MOD2
	bool "Enable mod2 module"
	config MOD3
	bool "Enable mod3 module"
endmenu


config EXAMPLE_BOOL_VAR
	bool "Set a example bool variable"
	---help---
	      This is an example bool variable define within the kconfig
	      autoconf addon.

config EXAMPLE_STRING_VAR
	string "get value for EXAMPLE_STRING_VAR"
	---help---
	      This is an example string variable define within the kconfig
	      autoconf addon.

comment "Build Options "

# //////////////////////////////////////////////////////////////////////////// #
# //  TOOLCHAIN  ///////////////////////////////////////////////////////////// #
# //////////////////////////////////////////////////////////////////////////// #

  source conf/scripts/toolchain.kconfig


# //////////////////////////////////////////////////////////////////////////// #
# //  DOCKER  //////////////////////////////////////////////////////////////// #
# //////////////////////////////////////////////////////////////////////////// #

  source conf/scripts/docker.kconfig
```

## kconfig/Kconfig
```kconfig
#
# For a description of the syntax of this configuration file,
# see Documentation/kbuild/kconfig-language.txt.
#
mainmenu "Linux/$ARCH $KERNELVERSION Kernel Configuration"

config MODVERSIONS
	bool "Set version information on all module symbols"

# config SRCARCH
#	string
#	option env="SRCARCH"

# source "arch/$SRCARCH/Kconfig"
```
